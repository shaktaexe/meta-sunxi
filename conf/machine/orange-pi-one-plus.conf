## conf/machine/orange-pi-one-plus.conf
```bitbake
#@TYPE: Machine
#@NAME: orange-pi-one-plus
#@DESCRIPTION: Machine configuration for the Orange Pi One Plus, based on Allwinner H6 CPU


require conf/machine/include/sun50i-h6.inc

KERNEL_DEVICETREE = "sun50i-h6-orangepi-one-plus.dtb"
UBOOT_MACHINE = "orangepi_one_plus_defconfig"
```

## conf/machine/orange-pi-plus2e.conf
```bitbake
#@TYPE: Machine
#@NAME: orange-pi-plus2e
#@DESCRIPTION: Machine configuration for the orange-pi-plus2e, base on allwinner H3 CPU

require conf/machine/include/sun8i.inc

KERNEL_DEVICETREE = "sun8i-h3-orangepi-plus2e.dtb"
UBOOT_MACHINE = "orangepi_plus2e_defconfig"
```

## conf/machine/orange-pi-zero2.conf
```bitbake
#@TYPE: Machine
#@NAME: orange-pi-zero-2
#@DESCRIPTION: Machine configuration for the orange-pi-zero-2, based on Allwinner H616 CPU

require conf/machine/include/sun50i.inc

PREFERRED_PROVIDER_virtual/kernel = "linux-h616"
KERNEL_DEVICETREE = "allwinner/sun50i-h616-orangepi-zero2.dtb"
UBOOT_MACHINE = "orangepi_zero2_defconfig"

UBOOT_BINARY = "u-boot-nodtb.bin"
SPL_BINARY = "u-boot-sunxi-with-spl.bin"

MACHINEOVERRIDES:append = "sun50i:sun50i-h616:"

# as for now neither graphics nor audio is supported
MACHINE_FEATURES:remove = "alsa x11"
```
